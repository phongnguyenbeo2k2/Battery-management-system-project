/*
 * TFT_ST7735.c
 *
 *  Created on: Dec 29, 2023
 *      Author: Acer
 */

#include "TFT.h"

int16_t _width_t;       ///< Display width as modified by current rotation
int16_t _height_t;      ///< Display height as modified by current rotation
int16_t cursor_x_t;     ///< x location to start print()ing text
int16_t cursor_y_t;     ///< y location to start print()ing text
uint8_t rotation_t;     ///< Display rotation (0 thru 3)
uint8_t _colstart_t;   ///< Some displays need this changed to offset
uint8_t _rowstart_t;       ///< Some displays need this changed to offset
uint8_t _xstart_t;
uint8_t _ystart_t;

const uint8_t
 init_cmds1[] = {            // Init for 7735R, part 1 (red or green tab)
   15,                       // 15 commands in list:
   ST7735_SWRESET,   DELAY,  //  1: Software reset, 0 args, w/delay
     150,                    //     150 ms delay
   ST7735_SLPOUT ,   DELAY,  //  2: Out of sleep mode, 0 args, w/delay
     255,                    //     500 ms delay
   ST7735_FRMCTR1, 3      ,  //  3: Frame rate ctrl - normal mode, 3 args:
     0x01, 0x2C, 0x2D,       //     Rate = fosc/(1x2+40) * (LINE+2C+2D)
   ST7735_FRMCTR2, 3      ,  //  4: Frame rate control - idle mode, 3 args:
     0x01, 0x2C, 0x2D,       //     Rate = fosc/(1x2+40) * (LINE+2C+2D)
   ST7735_FRMCTR3, 6      ,  //  5: Frame rate ctrl - partial mode, 6 args:
     0x01, 0x2C, 0x2D,       //     Dot inversion mode
     0x01, 0x2C, 0x2D,       //     Line inversion mode
   ST7735_INVCTR , 1      ,  //  6: Display inversion ctrl, 1 arg, no delay:
     0x07,                   //     No inversion
   ST7735_PWCTR1 , 3      ,  //  7: Power control, 3 args, no delay:
     0xA2,
     0x02,                   //     -4.6V
     0x84,                   //     AUTO mode
   ST7735_PWCTR2 , 1      ,  //  8: Power control, 1 arg, no delay:
     0xC5,                   //     VGH25 = 2.4C VGSEL = -10 VGH = 3 * AVDD
   ST7735_PWCTR3 , 2      ,  //  9: Power control, 2 args, no delay:
     0x0A,                   //     Opamp current small
     0x00,                   //     Boost frequency
   ST7735_PWCTR4 , 2      ,  // 10: Power control, 2 args, no delay:
     0x8A,                   //     BCLK/2, Opamp current small & Medium low
     0x2A,
   ST7735_PWCTR5 , 2      ,  // 11: Power control, 2 args, no delay:
     0x8A, 0xEE,
   ST7735_VMCTR1 , 1      ,  // 12: Power control, 1 arg, no delay:
     0x0E,
   ST7735_INVOFF , 0      ,  // 13: Don't invert display, no args, no delay
   ST7735_COLMOD , 1      ,  // 15: set color mode, 1 arg, no delay:
     0x05 },                 //     16-bit color

 init_cmds2[] = {            // Init for 7735R, part 2 (1.44" display)
   2,                        //  2 commands in list:
   ST7735_CASET  , 4      ,  //  1: Column addr set, 4 args, no delay:
     0x00, 0x00,             //     XSTART = 0
     0x00, 0x7F,             //     XEND = 127
   ST7735_RASET  , 4      ,  //  2: Row addr set, 4 args, no delay:
     0x00, 0x00,             //     XSTART = 0
     0x00, 0x7F },           //     XEND = 127
 init_cmds3[] = {            // Init for 7735R, part 3 (red or green tab)
   4,                        //  4 commands in list:
   ST7735_GMCTRP1, 16      , //  1: Magical unicorn dust, 16 args, no delay:
     0x02, 0x1c, 0x07, 0x12,
     0x37, 0x32, 0x29, 0x2d,
     0x29, 0x25, 0x2B, 0x39,
     0x00, 0x01, 0x03, 0x10,
   ST7735_GMCTRN1, 16      , //  2: Sparkles and rainbows, 16 args, no delay:
     0x03, 0x1d, 0x07, 0x06,
     0x2E, 0x2C, 0x29, 0x2D,
     0x2E, 0x2E, 0x37, 0x3F,
     0x00, 0x00, 0x02, 0x10,
   ST7735_NORON  ,    DELAY, //  3: Normal display on, no args, w/delay
     10,                     //     10 ms delay
   ST7735_DISPON ,    DELAY, //  4: Main screen turn on, no args w/delay
     100 };                  //     100 ms delay

static const uint16_t Font7x10_t [] = {
0x0000, 0x0000, 0x0000, 0x0000, 0x0000, 0x0000, 0x0000, 0x0000, 0x0000, 0x0000,  // sp
0x1000, 0x1000, 0x1000, 0x1000, 0x1000, 0x1000, 0x0000, 0x1000, 0x0000, 0x0000,  // !
0x2800, 0x2800, 0x2800, 0x0000, 0x0000, 0x0000, 0x0000, 0x0000, 0x0000, 0x0000,  // "
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0x0000, 0x0000, 0x0000, 0x7400, 0x4C00, 0x0000, 0x0000, 0x0000, 0x0000, 0x0000,  // ~
};

static const uint16_t Font11x18_t [] = {
0x0000, 0x0000, 0x0000, 0x0000, 0x0000, 0x0000, 0x0000, 0x0000, 0x0000, 0x0000, 0x0000, 0x0000, 0x0000, 0x0000, 0x0000, 0x0000, 0x0000, 0x0000,   // sp
0x0000, 0x0C00, 0x0C00, 0x0C00, 0x0C00, 0x0C00, 0x0C00, 0x0C00, 0x0C00, 0x0C00, 0x0C00, 0x0C00, 0x0000, 0x0C00, 0x0C00, 0x0000, 0x0000, 0x0000,   // !
0x0000, 0x1B00, 0x1B00, 0x1B00, 0x1B00, 0x1B00, 0x0000, 0x0000, 0x0000, 0x0000, 0x0000, 0x0000, 0x0000, 0x0000, 0x0000, 0x0000, 0x0000, 0x0000,   // "
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0x0000, 0x0000, 0x0000, 0x0000, 0x0000, 0x0000, 0x0000, 0x3880, 0x7F80, 0x4700, 0x0000, 0x0000, 0x0000, 0x0000, 0x0000, 0x0000, 0x0000, 0x0000,   // ~
};

static const uint16_t Font16x26_t [] = {
0x0000,0x0000,0x0000,0x0000,0x0000,0x0000,0x0000,0x0000,0x0000,0x0000,0x0000,0x0000,0x0000,0x0000,0x0000,0x0000,0x0000,0x0000,0x0000,0x0000,0x0000,0x0000,0x0000,0x0000,0x0000,0x0000, // Ascii = [ ]
0x03E0,0x03E0,0x03E0,0x03E0,0x03E0,0x03E0,0x03E0,0x03E0,0x03C0,0x03C0,0x01C0,0x01C0,0x01C0,0x01C0,0x01C0,0x0000,0x0000,0x0000,0x03E0,0x03E0,0x03E0,0x0000,0x0000,0x0000,0x0000,0x0000, // Ascii = [!]
0x1E3C,0x1E3C,0x1E3C,0x1E3C,0x1E3C,0x1E3C,0x1E3C,0x0000,0x0000,0x0000,0x0000,0x0000,0x0000,0x0000,0x0000,0x0000,0x0000,0x0000,0x0000,0x0000,0x0000,0x0000,0x0000,0x0000,0x0000,0x0000, // Ascii = ["]
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0x0000,0x0000,0x0000,0x0000,0x0000,0x0000,0x0000,0x0000,0x0000,0x0000,0x0000,0x3F07,0x7FC7,0x73E7,0xF1FF,0xF07E,0x0000,0x0000,0x0000,0x0000,0x0000,0x0000,0x0000,0x0000,0x0000,0x0000, // Ascii = [~]
};

TFT_ST7735_FontDef_t Font_7x10_t = {7,10,Font7x10_t};
TFT_ST7735_FontDef_t Font_11x18_t = {11,18,Font11x18_t};
TFT_ST7735_FontDef_t Font_16x26_t = {16,26,Font16x26_t};

void TFT_ST7735_init_info(TFT_ST7735_Info_t *foo_tft, GPIO_TypeDef *foo_cs_port, uint16_t foo_cs_pin, GPIO_TypeDef *foo_dc_port, uint16_t foo_dc_pin, GPIO_TypeDef *foo_rst_port, uint16_t foo_rst_pin,SPI_HandleTypeDef *foo_tft_hspi, TFT_ST7735_SCREEN_TYPE_t foo_tft_type)
{
	foo_tft->cs_port = foo_cs_port;
	foo_tft->cs_pin = foo_cs_pin;
	foo_tft->dc_port = foo_dc_port;
	foo_tft->dc_pin = foo_dc_pin;
	foo_tft->rst_port = foo_rst_port;
	foo_tft->rst_pin = foo_rst_pin;
	foo_tft->tft_hspi = foo_tft_hspi;
	foo_tft->tft_type = foo_tft_type;

	if (foo_tft_type == TFT_ST7735_160x128)
	{
		foo_tft->tft_max_height_size = 160;
		foo_tft->tft_max_width_size = 128;
	}else if (foo_tft_type == TFT_ST7735_120x128)
	{
		foo_tft->tft_max_height_size = 120;
		foo_tft->tft_max_width_size = 128;
	}else
	{
		foo_tft->tft_max_height_size = 160;
		foo_tft->tft_max_width_size = 80;
	}
}

void TFT_ST7735_Unselect(TFT_ST7735_Info_t *foo_tft)
{
	HAL_GPIO_WritePin(foo_tft->cs_port, foo_tft->cs_pin, GPIO_PIN_SET);
}
void TFT_ST7735_Select(TFT_ST7735_Info_t *foo_tft)
{
	HAL_GPIO_WritePin(foo_tft->cs_port, foo_tft->cs_pin, GPIO_PIN_RESET);
}

void TFT_ST7735_Reset(TFT_ST7735_Info_t *foo_tft)
{
	HAL_GPIO_WritePin(foo_tft->rst_port, foo_tft->rst_pin, GPIO_PIN_RESET);
	HAL_Delay(5);
	HAL_GPIO_WritePin(foo_tft->rst_port, foo_tft->rst_pin, GPIO_PIN_SET);
}
void TFT_ST7735_Write_command(TFT_ST7735_Info_t *foo_tft, uint8_t cmd)
{
	HAL_GPIO_WritePin(foo_tft->dc_port, foo_tft->dc_pin, GPIO_PIN_RESET);
	HAL_SPI_Transmit(foo_tft->tft_hspi, &cmd, sizeof(cmd), HAL_MAX_DELAY);
}
void TFT_ST7735_Write_data(TFT_ST7735_Info_t *foo_tft, uint8_t *buff, size_t buff_size)
{
	HAL_GPIO_WritePin(foo_tft->dc_port, foo_tft->dc_pin, GPIO_PIN_SET);
	HAL_SPI_Transmit(foo_tft->tft_hspi, buff, buff_size, HAL_MAX_DELAY);
}
void TFT_ST7735_Display_init(TFT_ST7735_Info_t *foo_tft, const uint8_t *addr)
{
    uint8_t numCommands, numArgs;
    uint16_t ms;

    numCommands = *addr++;
    while(numCommands--) {
        uint8_t cmd = *addr++;
        TFT_ST7735_Write_command(foo_tft,cmd);

        numArgs = *addr++;
        // If high bit set, delay follows args
        ms = numArgs & DELAY;
        numArgs &= ~DELAY;
        if(numArgs) {
            TFT_ST7735_Write_data(foo_tft,(uint8_t*)addr, numArgs);
            addr += numArgs;
        }

        if(ms) {
            ms = *addr++;
            if(ms == 255) ms = 500;
            HAL_Delay(ms);
        }
    }
}
void TFT_ST7735_Set_address_window(TFT_ST7735_Info_t *foo_tft, uint8_t x0, uint8_t y0, uint8_t x1, uint8_t y1)
{
	// column address set
	TFT_ST7735_Write_command(foo_tft, ST7735_CASET);
	uint8_t data[] = { 0x00, x0 + _xstart_t, 0x00, x1 + _xstart_t };
	TFT_ST7735_Write_data(foo_tft, data, sizeof(data));

	// row address set
	TFT_ST7735_Write_command(foo_tft, ST7735_RASET);
	data[1] = y0 + _ystart_t;
	data[3] = y1 + _ystart_t;
	TFT_ST7735_Write_data(foo_tft, data, sizeof(data));
    // write to RAM
	TFT_ST7735_Write_command(foo_tft, ST7735_RAMWR);
}

void TFT_ST7735_Set_rotation(TFT_ST7735_Info_t *foo_tft, uint8_t m)
{
	uint8_t madctl = 0;
	rotation_t = m % 4;
	switch(rotation_t)
	{
	case 0:
		if (foo_tft->tft_type == TFT_ST7735_160x80)
		{
			madctl = ST7735_MADCTL_MX | ST7735_MADCTL_MY | ST7735_MADCTL_BGR;
		}else
		{
		      madctl = ST7735_MADCTL_MX | ST7735_MADCTL_MY | ST7735_MADCTL_RGB;
		      _height_t = foo_tft->tft_max_height_size;
		      _width_t = foo_tft->tft_max_width_size;
		      _xstart_t = _colstart_t;
		      _ystart_t = _rowstart_t;
		}
		break;
	case 1:
		if (foo_tft->tft_type == TFT_ST7735_160x80)
		{
			madctl = ST7735_MADCTL_MY | ST7735_MADCTL_MV | ST7735_MADCTL_BGR;
		}else
		{
		      madctl = ST7735_MADCTL_MY | ST7735_MADCTL_MV | ST7735_MADCTL_RGB;
		      _width_t = foo_tft->tft_max_height_size;
		      _height_t = foo_tft->tft_max_width_size;
		    _ystart_t = _colstart_t;
		    _xstart_t = _rowstart_t;
		}
		break;
	case 2:
		if (foo_tft->tft_type == TFT_ST7735_160x80)
		{
			  madctl = ST7735_MADCTL_BGR;
		}else
		{
		      madctl = ST7735_MADCTL_RGB;
		      _height_t = foo_tft->tft_max_height_size;
		      _width_t = foo_tft->tft_max_width_size;
		    _xstart_t = _colstart_t;
		    _ystart_t = _rowstart_t;
		}
		break;
	case 3:
		if (foo_tft->tft_type == TFT_ST7735_160x80)
		{
			madctl = ST7735_MADCTL_MX | ST7735_MADCTL_MV | ST7735_MADCTL_BGR;
		}else
		{
		      madctl = ST7735_MADCTL_MX | ST7735_MADCTL_MV | ST7735_MADCTL_RGB;
		      _width_t = foo_tft->tft_max_height_size;
		      _height_t = foo_tft->tft_max_width_size;
		    _ystart_t = _colstart_t;
		    _xstart_t = _rowstart_t;
		}
		break;
	}
	TFT_ST7735_Select(foo_tft);
	TFT_ST7735_Write_command(foo_tft, ST7735_MADCTL);
	TFT_ST7735_Write_data(foo_tft, &madctl, 1);
	TFT_ST7735_Unselect(foo_tft);
}
void TFT_ST7735_Run(TFT_ST7735_Info_t *foo_tft, uint8_t rotation)
{
	TFT_ST7735_Select(foo_tft);
	TFT_ST7735_Reset(foo_tft);
	TFT_ST7735_Display_init(foo_tft, init_cmds1);
	if ((foo_tft->tft_type == TFT_ST7735_160x128) || (foo_tft->tft_type == TFT_ST7735_120x128))
	{
		TFT_ST7735_Display_init(foo_tft, init_cmds2);
	}else
	{
		TFT_ST7735_Display_init(foo_tft, init_cmds2);
	}
	TFT_ST7735_Display_init(foo_tft, init_cmds3);

	if (foo_tft->tft_type == TFT_ST7735_160x80)
	{
	    _colstart_t = 24;
	    _rowstart_t = 0;
	 /*****  IF Doesn't work, remove the code below (before #elif) *****/
	    uint8_t data = 0xC0;
	    TFT_ST7735_Select(foo_tft);
	    TFT_ST7735_Write_command(foo_tft, ST7735_MADCTL);
	    TFT_ST7735_Write_data(foo_tft, &data, 1);
	    TFT_ST7735_Unselect(foo_tft);
	}else if (foo_tft->tft_type == TFT_ST7735_120x128)
	{
	    _colstart_t = 2;
	    _rowstart_t = 3;
	}else
	{
	    _colstart_t = 0;
	    _rowstart_t = 0;
	}
	TFT_ST7735_Set_rotation(foo_tft, rotation);
	TFT_ST7735_Unselect(foo_tft);
}

void TFT_ST7735_Draw_pixel(TFT_ST7735_Info_t *foo_tft, uint16_t x, uint16_t y, uint16_t color)
{
	if (x >= _width_t || y >= _height_t)
	{
		return;
	}
	TFT_ST7735_Select(foo_tft);
	TFT_ST7735_Set_address_window(foo_tft, x, y, x+1, y+1);
	uint8_t data[] = { color >> 8, color & 0xFF };
	TFT_ST7735_Write_data(foo_tft, data, sizeof(data));
	TFT_ST7735_Unselect(foo_tft);
}

void TFT_ST7735_Write_char(TFT_ST7735_Info_t *foo_tft, uint16_t x, uint16_t y, char ch, TFT_ST7735_FontDef_t font, uint16_t color, uint16_t bgcolor)
{
	uint32_t i, b, j;
	TFT_ST7735_Set_address_window(foo_tft, x, y, x+font.width-1, y+font.height-1);
    for(i = 0; i < font.height; i++) {
        b = font.data[(ch - 32) * font.height + i];
        for(j = 0; j < font.width; j++) {
            if((b << j) & 0x8000)  {
                uint8_t data[] = { color >> 8, color & 0xFF };
                TFT_ST7735_Write_data(foo_tft, data, sizeof(data));
            } else {
                uint8_t data[] = { bgcolor >> 8, bgcolor & 0xFF };
                TFT_ST7735_Write_data(foo_tft, data, sizeof(data));
            }
        }
    }
}

void TFT_ST7735_Write_string(TFT_ST7735_Info_t *foo_tft, uint16_t x, uint16_t y, const char* str, TFT_ST7735_FontDef_t font, uint16_t color, uint16_t bgcolor)
{
	TFT_ST7735_Select(foo_tft);

    while(*str) {
        if(x + font.width >= _width_t) {
            x = 0;
            y += font.height;
            if(y + font.height >= _height_t)
            {
                break;
            }

            if(*str == ' ')
            {
                // skip spaces in the beginning of the new line
                str++;
                continue;
            }
        }

        TFT_ST7735_Write_char(foo_tft, x, y, *str, font, color, bgcolor);
        x += font.width;
        str++;
    }
    TFT_ST7735_Unselect(foo_tft);
}

void TFT_ST7735_Fill_rectangle(TFT_ST7735_Info_t *foo_tft, uint16_t x, uint16_t y, uint16_t w, uint16_t h, uint16_t color)
{
    if((x >= _width_t) || (y >= _height_t)) return;
    if((x + w - 1) >= _width_t) w = _width_t - x;
    if((y + h - 1) >= _height_t) h = _height_t - y;

    TFT_ST7735_Select(foo_tft);
    TFT_ST7735_Set_address_window(foo_tft, x, y, x+w-1, y+h-1);

    uint8_t data[] = { color >> 8, color & 0xFF };
	HAL_GPIO_WritePin(foo_tft->dc_port, foo_tft->dc_pin, GPIO_PIN_SET);

    for(y = h; y > 0; y--) {
        for(x = w; x > 0; x--) {
            HAL_SPI_Transmit(foo_tft->tft_hspi, data, sizeof(data), HAL_MAX_DELAY);
        }
    }

    TFT_ST7735_Unselect(foo_tft);
}
void TFT_ST7735_Draw_image(TFT_ST7735_Info_t *foo_tft, uint16_t x, uint16_t y, uint16_t w, uint16_t h, const uint16_t* data)
{
    if((x >= _width_t) || (y >= _height_t)) return;
    if((x + w - 1) >= _width_t) return;
    if((y + h - 1) >= _height_t) return;

    TFT_ST7735_Select(foo_tft);
    TFT_ST7735_Set_address_window(foo_tft, x, y, x+w-1, y+h-1);
    TFT_ST7735_Write_data(foo_tft,(uint8_t*)data, sizeof(uint16_t)*w*h);
    TFT_ST7735_Unselect(foo_tft);
}

void TFT_ST7735_InvertColors(TFT_ST7735_Info_t *foo_tft, bool invert)
{
	TFT_ST7735_Select(foo_tft);
	TFT_ST7735_Write_command(foo_tft, (invert ? ST7735_INVON : ST7735_INVOFF));
	TFT_ST7735_Unselect(foo_tft);
}

void TFT_ST7735_Display_off(TFT_ST7735_Info_t *foo_tft)
{
	TFT_ST7735_Select(foo_tft);
	TFT_ST7735_Write_command(foo_tft, ST7735_DISPOFF);
	HAL_Delay(10);
	TFT_ST7735_Unselect(foo_tft);
}

void TFT_St7735_Display_on(TFT_ST7735_Info_t *foo_tft)
{
	TFT_ST7735_Select(foo_tft);
	TFT_ST7735_Write_command(foo_tft, ST7735_DISPON);
	HAL_Delay(10);
	TFT_ST7735_Unselect(foo_tft);
}

#define _swap_int16_t(a, b)                                                    \
  {                                                                            \
    int16_t t = a;                                                             \
    a = b;                                                                     \
    b = t;                                                                     \
  }

#define min(a, b) (((a) < (b)) ? (a) : (b))


void TFT_ST7735_drawPixel(TFT_ST7735_Info_t *foo_tft, int16_t x, int16_t y, uint16_t color)
{
	TFT_ST7735_Draw_pixel(foo_tft, x, y, color);
}
void TFT_ST7735_writePixel(TFT_ST7735_Info_t *foo_tft, int16_t x, int16_t y, uint16_t color)
{
	TFT_ST7735_drawPixel(foo_tft, x, y, color);
}
void TFT_ST7735_writeLine(TFT_ST7735_Info_t *foo_tft, int16_t x0, int16_t y0, int16_t x1, int16_t y1, uint16_t color)
{
    int16_t steep = abs(y1 - y0) > abs(x1 - x0);
    if (steep) {
        _swap_int16_t(x0, y0);
        _swap_int16_t(x1, y1);
    }

    if (x0 > x1) {
        _swap_int16_t(x0, x1);
        _swap_int16_t(y0, y1);
    }

    int16_t dx, dy;
    dx = x1 - x0;
    dy = abs(y1 - y0);

    int16_t err = dx / 2;
    int16_t ystep;

    if (y0 < y1) {
        ystep = 1;
    } else {
        ystep = -1;
    }

    for (; x0<=x1; x0++) {
        if (steep) {
            TFT_ST7735_writePixel(foo_tft, y0, x0, color);
        } else {
            TFT_ST7735_writePixel(foo_tft, x0, y0, color);
        }
        err -= dy;
        if (err < 0) {
            y0 += ystep;
            err += dx;
        }
    }
}
void TFT_ST7735_drawFastVLine(TFT_ST7735_Info_t *foo_tft, int16_t x, int16_t y, int16_t h, uint16_t color)
{
	TFT_ST7735_writeLine(foo_tft, x, y, x, y + h - 1, color);
}
void TFT_ST7735_drawFastHLine(TFT_ST7735_Info_t *foo_tft, int16_t x, int16_t y, int16_t w, uint16_t color)
{
	TFT_ST7735_writeLine(foo_tft, x, y, x + w - 1, y, color);
}

void TFT_ST7735_drawLine(TFT_ST7735_Info_t *foo_tft, int16_t x0, int16_t y0, int16_t x1, int16_t y1, uint16_t color)
{
    if(x0 == x1){
        if(y0 > y1) _swap_int16_t(y0, y1);
        TFT_ST7735_drawFastVLine(foo_tft, x0, y0, y1 - y0 + 1, color);
    } else if(y0 == y1){
        if(x0 > x1) _swap_int16_t(x0, x1);
        TFT_ST7735_drawFastHLine(foo_tft, x0, y0, x1 - x0 + 1, color);
    } else {
        TFT_ST7735_writeLine(foo_tft, x0, y0, x1, y1, color);
    }
}
void TFT_ST7735_fillRect(TFT_ST7735_Info_t *foo_tft, int16_t x, int16_t y, int16_t w, int16_t h, uint16_t color)
{
	TFT_ST7735_Fill_rectangle(foo_tft, x, y, w, h, color);
}
void TFT_ST7735_fillScreen(TFT_ST7735_Info_t *foo_tft, uint16_t color)
{
    TFT_ST7735_fillRect(foo_tft, 0, 0, _width_t, _height_t, color);
}
